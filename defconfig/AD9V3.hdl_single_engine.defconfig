## scripts/Kconfig
```kconfig
###############################################################################
#
# SNAP Configuration Assistant
#   Please select card and appropriate options
#
###############################################################################

choice
	bool "Card Type  "
	default AD9V3
	help
	  Card Type
	  There are multiple cards the framework supports. Please select
	  one of them.

	config AD9V3
		bool "OpenCAPI3.0: AlphaData 9V3 (VU3P with DDR)"
		select OPENCAPI30
		select DISABLE_NVME
		help
		  AlphaData 9V3 has ethernet and 16GB DDR4 SDRAM. Uses Xilinx FPGA VU3P.

	config AD9H3
		bool "OpenCAPI3.0: AlphaData 9H3 (incl. VU33P with HBM)"
		select OPENCAPI30
		select DISABLE_NVME
		help
		  AlphaData 9H3 has ethernet and 2x 4GB HBM Gen2. Uses Xilinx FPGA VU33P.

	config AD9H335
		bool "OpenCAPI3.0: AlphaData 9H3-35 (incl. VU35P with HBM) (under development)"
		select OPENCAPI30
		select DISABLE_NVME
		help
		  AlphaData 9H3 has ethernet and 2x 4GB HBM Gen2. Uses Xilinx FPGA VU35P.

	config AD9H7
		bool "OpenCAPI3.0: AlphaData 9H7 (VU37P with HBM)"
		select OPENCAPI30
		select DISABLE_NVME
		help
		  AlphaData 9H7 has ethernet and 2x 4GB HBM Gen2. Uses Xilinx FPGA VU37P.

	config BW250SOC
		bool "OpenCAPI3.0: Bittware 250SOC (ZU19EG with DDR)"
		select OPENCAPI30
		select DISABLE_NVME
		select ENABLE_FLASH
		help
		  Bittware 250SOC has ethernet and 8GB DDR4 SDRAM each on PL and PS side. Uses Xilinx ZynqMP SOC ZU19EG.
	
endchoice


config FPGACARD
	string
	default "AD9V3"  if AD9V3
	default "BW250SOC"  if BW250SOC
	default "AD9H3"  if AD9H3
	default "AD9H335"  if AD9H335
	default "AD9H7"  if AD9H7

config FLASH_INTERFACE
	string
	default "SPIx8"  if  AD9V3 || AD9H3 || AD9H335 || AD9H7 || BW250SOC

#FLASH_SIZE: in MB
config FLASH_SIZE
	string
	default 128 if AD9H7 || AD9H335
	default 64  if AD9V3 || AD9H3 || BW250SOC

#FLASH_FACTORYADDR: For all cards, factory address is 0x0
config FLASH_FACTORYADDR
        string
        default 0x00000000

#FLASH_USERADDR: For SPI, it is byte address.
config FLASH_USERADDR
	string
	default 0x08000000 if AD9V3 || AD9H3 || AD9H335 || AD9H7 || BW250SOC

config OPENCAPI30
	bool
	default y

config CAPI_VER
	string
	default "opencapi30" if OPENCAPI30

config FPGACHIP
	string
	default "xcvu3p-ffvc1517-2-e" if AD9V3
	default "xczu19eg-ffvd1760-2-i" if BW250SOC
	default "xcvu33p-fsvh2104-2-e" if AD9H3
	default "xcvu35p-fsvh2104-2-e" if AD9H335
	default "xcvu37p-fsvh2892-2-e" if AD9H7

config NUM_OF_ACTIONS
	int
	default 1
# as long as only one action is supported we do not need to prompt the number of actions
# prompt should be enabled as soon as multiple action support is implemented
#        prompt "Number Of Actions"
	range 1 1
	help
	  SNAP currently supports one action.

choice
	bool "Action Type"
	help
	  Action Type
	  Select an Action type example:
	  - HDL for VHDL or Verilog coded examples
	  - HLS for C coded examples compiled with HLS

	default HDL_EXAMPLE

	config HDL_ACTION
		bool "HDL Action - manually set ACTION_ROOT in snap_env.sh!"
		help
		  This option is a placeholder for an action written by the user in a
		  hardware description language such as VHDL or Verilog.
		  Please remember to set the environment variable "ACTION_ROOT"
		  in snap_env.sh to the directory of the action source code.
		  Also need to select the AXI data width to host is 512b or 1024b.

	config HDL_EXAMPLE
		bool "HDL Example"
		select ACTION_HALF_WIDTH
		select DISABLE_HBM
	
	config HDL_SINGLE_ENGINE
		bool "HDL Single Engine"
		help
		  This is a very simple example written in Verilog for
		  - Action Register example (axi_lite_slave)
		  - Read data from server memory and check whether its right data
		  - Write data to server memory
		select DISABLE_SDRAM_AND_BRAM
		select DISABLE_ETHERNET
		select DISABLE_HBM

#experimental - not available yet
#	config HDL_MULTI_PROCESS
#		bool "HDL Multi-Process"
#		help
#		  This is a very simple example written in Verilog for
#		  - Multi-process testing
#		select DISABLE_SDRAM_AND_BRAM

#experimental - not available yet
#	config HDL_UNIT_SIM
#		bool "HDL UNIT SIM"
#		help
#		  This is a random/configrable test for bridge mode
#		  - This action include an AXI-master vip 
#		  - Generate random AXI read/write commands
#		  - Data check rely on verification code
#		  - No OCSE and software will be invoked for this action
#                  - Only UVM based testbench
#		select DISABLE_SDRAM_AND_BRAM

	config HLS_ACTION
		bool "HLS Action - manually set ACTION_ROOT in snap_env.sh!"
		select ENABLE_HLS_SUPPORT
		help
		  This option is a placeholder for an action written by the user in HLS.
		  Please remember to set the environment variable "ACTION_ROOT"
		  in snap_env.sh to the directory of the action source code.
		  Also need to select the AXI data width to host is 512b or 1024b.

	config HLS_HELLOWORLD_512
		bool "HLS HelloWorld 512b    (Action to Host I/F = 512b)"
		help
		  This is the simplest example to start with:
		  - Reading text from the server memory
		  - Processing changing case of the text
		  - Writing back the text to the server memory
		  This example is written in C and compiled with HLS
		select ENABLE_HLS_SUPPORT
		select DISABLE_SDRAM_AND_BRAM
		select DISABLE_NVME
		select DISABLE_HBM
		select ACTION_HALF_WIDTH
		select DISABLE_ETHERNET

        config HLS_HELLOWORLD_1024
                bool "HLS HelloWorld 1024b   (Action to Host I/F =1024b)"
                help
                  This is the simplest example to start with:
                  - Reading text from the server memory
                  - Processing changing case of the text
                  - Writing back the text to the server memory
                  This example is written in C and compiled with HLS 
                select ENABLE_HLS_SUPPORT
                select DISABLE_SDRAM_AND_BRAM
                select DISABLE_NVME
		select DISABLE_HBM
		select DISABLE_ETHERNET

        config HLS_HELLOWORLD_PYTHON
                bool "HLS Helloworld Python  (Action to Host I/F =1024b)"
                help
                  This is a basic example to start accessing data using python scripting:
                  - Reading text from the server memory
                  - Processing changing case of the text
                  - Writing back the text to the server memory
                  This example is written in C and compiled with HLS
                  It does the minimum exchanges between host mem and the FPGA
                  and is aimed at being called by a python script
                select ENABLE_HLS_SUPPORT
                select DISABLE_SDRAM_AND_BRAM
        	select DISABLE_NVME
        	select DISABLE_HBM
		select DISABLE_ETHERNET

	config HLS_MEMCOPY_512
		bool "HLS Memcopy 512b       (Action to Host I/F = 512b)"
                depends on ! (AD9H3 || AD9H335 || AD9H7)
		help
		  This is a basic example to start accessing data:
		  - Read data from the server memory or from the card DDR
		  - Write data to the server memory or to the card DDR
		  - A temporary buffer is used in the FPGA (configurable size)
		  All combination can be done.
		  This example is written in C and compiled with HLS
		select ENABLE_HLS_SUPPORT
		select FORCE_SDRAM_OR_BRAM
		select DISABLE_NVME
		select DISABLE_ETHERNET
		select ACTION_HALF_WIDTH

	config HLS_MEMCOPY_1024
		bool "HLS Memcopy 1024b      (Action to Host I/F =1024b)"
                depends on ! (AD9H3 || AD9H335 || AD9H7)
		help
		  This is a basic example to start accessing data:
		  - Read data from the server memory or from the card DDR
		  - Write data to the server memory or to the card DDR
		  - A temporary buffer is used in the FPGA (configurable size)
		  All combination can be done.
		  This example is written in C and compiled with HLS
		select ENABLE_HLS_SUPPORT
		select FORCE_SDRAM_OR_BRAM
		select DISABLE_NVME
		select DISABLE_ETHERNET

	config HLS_HBM_MEMCOPY_1024
		bool "HLS HBM Memcopy 1024b  (Action to Host I/F =1024b)"
                depends on (AD9H3 || AD9H335 || AD9H7)
		help
		  This is a basic example to start accessing data:
		  - Read data from the server memory or from the FPGA HBM 
		  - Write data to the server memory or to the FPGA HBM 
		  - A temporary buffer is used in the FPGA (configurable size)
		  All combination can be done.
		  This example is written in C and compiled with HLS
		select ENABLE_HLS_SUPPORT
		select FORCE_SDRAM_OR_BRAM
		select DISABLE_ETHERNET

        config HLS_IMAGE_FILTER
                bool "HLS Image Filter       (Action to Host I/F = 512b)"
                help
                  This example:
                  - reads a bitmap image
                  - checks pixel one by one in FPGA block memory 
                  - modifies the pixel according to its color
                  - Writes the modified image back to a server file
                  This example is written in C and compiled with HLS 
                select ENABLE_HLS_SUPPORT
                select DISABLE_SDRAM_AND_BRAM
                select DISABLE_NVME
		select DISABLE_HBM
                select ACTION_HALF_WIDTH
		select DISABLE_ETHERNET

	config HLS_DECIMAL_MULT
		bool "HLS_Decimal_Mult       (Action to Host I/F = 512b)"
		help
		  This an example of decimal objects multiplication
		  This example is written in C and compiled with HLS
		select ENABLE_HLS_SUPPORT
		select DISABLE_SDRAM_AND_BRAM
		select DISABLE_NVME
		select DISABLE_HBM
		select ACTION_HALF_WIDTH
		select DISABLE_ETHERNET

	config HLS_UDP
		bool "HLS UDP 100G CMAC      (Action to Host I/F = 512b)"
                depends on (AD9H3 || AD9H335 || AD9H7)
		help
		   This example is written in C and compiled with HLS
		select ENABLE_HLS_SUPPORT
		select ENABLE_ETHERNET
		select ENABLE_SIMU_WO_ETH
                select DISABLE_SDRAM_AND_BRAM
		select DISABLE_HBM
		select ACTION_HALF_WIDTH
	
	config HLS_RX100G
		bool "HLS 100G RECEIVER      (Action to Host I/F = 512b)"
                depends on (AD9H3 || AD9H335 || AD9H7)
		help
		   This example is written in C and compiled with HLS
		select ENABLE_HLS_SUPPORT
		select ENABLE_ETHERNET
		select ENABLE_SIMU_WO_ETH
		select FORCE_SDRAM_OR_BRAM
		select FORCE_HBM

#	config HLS_SPONGE
#		bool "HLS Sponge"
#		help
#		  This is an example of a C code ported and optimized:
#		  It is a benchmark to measure the SHA3 key generation performance
#		  - Data are generated in the algorithm - No data move
#		  - 3 functions : SPEED, SHA3, SHAKE (and SHA3_SHAKE)
#		  - only the SPEED test was optimized
#		  This example is written in C and compiled with HLS
#		select ENABLE_HLS_SUPPORT
#		select DISABLE_SDRAM_AND_BRAM
#		select DISABLE_NVME
#		select ACTION_HALF_WIDTH
endchoice


# ACTION_HALF_WIDTH can be set to limit the width of the host data bus to 512b
config ACTION_HALF_WIDTH
	bool
	default n
	prompt "Action's AXI interface to host is 512b-wide ('y', checked) or 1024b ('n', unchecked)"
	depends on OPENCAPI30 && (HDL_ACTION || HLS_ACTION)
	help
	  Input 'Y' if your action's AXI interface to host is 512b.
	  Leave it unchecked if it is 1024b, which is a new choice in OC-Accel.

# HALF_WIDTH is "string": TRUE or FALSE
# ACTION_HALF_WIDTH is "bool": defined or not
config HALF_WIDTH
	string
	default "TRUE"  if ACTION_HALF_WIDTH
	default "FALSE" if !ACTION_HALF_WIDTH

config ENABLE_HLS_SUPPORT
	bool
	default n

config HLS_SUPPORT
	string
	default "TRUE"  if ENABLE_HLS_SUPPORT
	default "FALSE" if ! ENABLE_HLS_SUPPORT

config DISABLE_SDRAM_AND_BRAM
	bool
	default n

config FORCE_SDRAM_OR_BRAM
	bool
	default n

config FORCE_SDRAM
	bool
	default y
	depends on ((AD9V3 || BW250SOC) && FORCE_SDRAM_OR_BRAM && ! ENABLE_BRAM)
	select ENABLE_DDR

config ENABLE_DDR
	bool
	prompt "Enable DDR"
	depends on ((AD9V3 || BW250SOC) && ! (DISABLE_SDRAM_AND_BRAM || ENABLE_BRAM))
	help
	  This option enables the on-card SDRAM.
	  SNAP supports 8GB DDR4 on the AlphaData AD9V3 card.

config SDRAM_USED
	string
	default "TRUE"  if ENABLE_DDR
	default "FALSE" if ! ENABLE_DDR

config DISABLE_HBM
	bool
	default n

config FORCE_HBM
	bool
	default y
	#ddepends on ((AD9H3 || AD9H335 || AD9H7) && ! (DISABLE_SDRAM_AND_BRAM || ENABLE_BRAM))
	depends on (AD9H3 || AD9H335 || AD9H7) && ENABLE_HLS_SUPPORT && ! DISABLE_HBM
	select ENABLE_HBM

config ENABLE_HBM
	bool
	prompt "Enable HBM"
	#ddepends on ((AD9H3 || AD9H335 || AD9H7)  && ! (DISABLE_SDRAM_AND_BRAM || ENABLE_BRAM))
	depends on (AD9H3 || AD9H335 || AD9H7) && ! DISABLE_HBM
	help
	  This option enables the on-card HBM.

config HBM_USED
	string
	default "TRUE"  if ENABLE_HBM
	default "FALSE" if ! ENABLE_HBM

config ENABLE_BRAM
	bool
	prompt ">> Replace DDR by 512KB BRAM"
	depends on AD9V3 && ! (DISABLE_SDRAM_AND_BRAM || ENABLE_PRFLOW)
	help
	  This is a development option. The AXI attached on-card SDRAM will be replaced by 512KB BRAM.

config ENABLE_BRAM
	bool
	prompt ">> Replace HBM by 32KB URAM (recommended for simulating HBM)"
	depends on !AD9V3 && ! (DISABLE_SDRAM_AND_BRAM || ENABLE_PRFLOW)
	help
	  This is a development option. The AXI attached on-card SDRAM will be replaced by 32KB URAM.
	  As of today, there are still some issues to simulate the HBM even with some other simulators.
	  => xsim simulator doesn't support HBM simulation

config BRAM_USED
	string
	default "TRUE"  if (ENABLE_BRAM || REPLACE_HBM_BY_BRAM)
	default "FALSE" if ! (ENABLE_BRAM || REPLACE_HBM_BY_BRAM)

config ENABLE_DDR4
	bool
	default y
	depends on (ENABLE_DDR && (N250S || S121B || N250SP || AD8K5 || RCXVUP || FX609 || S241 || AD9V3 || BW250SOC))

config DDR4_USED
	string
	default "TRUE"  if ENABLE_DDR4
	default "FALSE" if ! ENABLE_DDR4

config ENABLE_DDRI
	bool
	default y
	depends on (ENABLE_DDR || ENABLE_BRAM)

config DDRI_USED
	string
	default "TRUE"  if ENABLE_DDRI
	default "FALSE" if ! ENABLE_DDRI


config DISABLE_NVME
	bool
	default n

config FORCE_NVME
	bool
	default n
	select ENABLE_NVME

config ENABLE_NVME
	bool "Enable NVMe"
	depends on ! DISABLE_NVME
	select FORCE_SDRAM_OR_BRAM
	help
	  This option controls the instantiation of an NVMe host controller
	  together with the AXI interfaces for MMIO control and action access.

config NVME_USED
	string
	default "TRUE"  if ENABLE_NVME
	default "FALSE" if ! ENABLE_NVME

config ENABLE_ETHERNET
        bool "Enable Ethernet support"
        default N
	depends on ((AD9V3 || AD9H3 || AD9H335 ) && ! (DISABLE_ETHERNET))
        help
          This option controls the instantiation of an Ethernet IP
          together with the AXI interfaces for MMIO control and action access.

config DISABLE_ETHERNET
        bool
        default n

config ENABLE_ETH_LOOP_BACK
         bool ">> Ethernet loopback in the action wrapper (no 100G MAC IP)"
         default "TRUE"  if  ENABLE_SIMU_WO_ETH
         default "FALSE" if !ENABLE_SIMU_WO_ETH
         depends on ((AD9H3 || AD9H335) && ENABLE_ETHERNET)
         help
           This option prevent the instantiation of an Ethernet IP
           Instead it shortens the action ethernet AXI out interface to ethernet input interface.

config ETH_LOOP_BACK
        string
        default "TRUE"  if  ENABLE_ETH_LOOP_BACK
        default "FALSE" if !ENABLE_ETH_LOOP_BACK

config ETHERNET_USED
        string
        default "TRUE"  if  ENABLE_ETHERNET
        default "FALSE" if !ENABLE_ETHERNET

config ETHERNET_RX_FIFO_DEPTH
        int
        prompt "Depth of receiving FIFO for Ethernet 100G MAC in 512-bit packets (must be power of 2)"
        depends on ENABLE_ETHERNET
        default 8192

config ETHERNET_RX_FIFO_URAM
	bool
        prompt "Force implementation of receiving FIFO for Ethernet 100G MAC in UltraRAM"
        depends on ENABLE_ETHERNET
        default n

config USER_CLOCK
	string
	default "TRUE"  if ACTION_USER_CLOCK
	default "FALSE" if ! ACTION_USER_CLOCK


config ACTION_USER_CLOCK
	bool
	default n

config HBM_AXI_IF_NUM
        prompt "Number of HBM AXI interfaces, range 1-32 (default 12)"
	depends on ENABLE_HBM
	int
	default 12 
	range 1 32
	help
	  HBM AXI interfaces generated in the chip
	  This need to be coherent with what is implemented in the HLS action code
          Please select one of them.

choice
	bool "Simulator"
	default SIM_XSIM
	help
	  Supported simulators are Xilinx' xsim, Cadence's ies and xcelium.
	  If NVMe support is enabled it is only possible to use ies
	  or to set the simulator to "nosim" to disable model build
	  and simulation.

	config SIM_XSIM
		bool "xsim"
		help
		  Default Xilinx simulator

	config SIM_IRUN
		bool "ies/irun"
		help
		  Cadence ies simulator (requires a specific license)
		  depends on ! ENABLE_PRFLOW

	config SIM_XCELIUM
		bool "xcelium"
		help
		  Cadence xcelium simulator (requires a specific license)
		  depends on ! ENABLE_PRFLOW

	config SIM_MODELSIM
		bool "modelsim"
		help
		  Mentor Modelsim AE/SE/DE simulator (requires a specific license)
		  depends on ! (ENABLE_PRFLOW || ENABLE_NVME)

	config SIM_QUESTA
		bool "questa"
		help
		  Mentor Questa simulator (requires a specific license)
		  depends on ! (ENABLE_PRFLOW || ENABLE_NVME)

	config NO_SIM
		bool "nosim"

endchoice

config NUM_OF_MULTI_PROCESS_ENGINES
        depends on HDL_MULTI_PROCESS
	prompt "Number of multi-process engines"
	int
	default 8
	range 1 16
	help
	  Number of engines in multi-process example.

config SIMULATOR
	string
	default "xsim"     if SIM_XSIM
	default "irun"     if SIM_IRUN
	default "xcelium"  if SIM_XCELIUM
	default "modelsim" if SIM_MODELSIM
	default "questa"   if SIM_QUESTA
	default "nosim"    if NO_SIM

config ENABLE_DENALI
	bool "Use Denali for NVMe simulation"
	depends on (ENABLE_NVME && (SIM_IRUN || SIM_XCELIUM))
	help
	  In order to use the Denali NVMe behavioral the corresponding Cadence licenses are required.

config DENALI_USED
	string
	default "TRUE"  if ENABLE_DENALI
	default "FALSE" if ! ENABLE_DENALI

config OCSE_PATH
	string "OCSE_ROOT: Path to OpenCAPI Simulation Engine Root"
	default "../ocse"

config ENABLE_9H3_LED
	bool "User LEDs on the board"
	depends on ( (AD9H3 || AD9H335) && (HDL_ACTION || HDL_EXAMPLE) )
	default n

config AD9H3_LED_USED
        string
        default "TRUE"  if ENABLE_9H3_LED
        default "FALSE" if ! ENABLE_9H3_LED

config ENABLE_9H3_EEPROM
	bool "I2C interface for on-board EEPROM (2kbit); WARNING! IOBUF and I2C need to be handled within action logic"
	depends on ( (AD9H3 || AD9H335) && (HDL_ACTION || HDL_EXAMPLE) )
	default n

config AD9H3_EEPROM_USED
        string
        default "TRUE"  if ENABLE_9H3_EEPROM
        default "FALSE" if ! ENABLE_9H3_EEPROM

config ENABLE_9H3_AVR
	bool "Serial interface for on-board management microcontroller; WARNING! Requires IP from (paid) reference design from Alpha Data to use it within the action"
	depends on ( (AD9H3 || AD9H335) && (HDL_ACTION || HDL_EXAMPLE) )
	default n
	default n

config AD9H3_AVR_USED
        string
        default "TRUE"  if ENABLE_9H3_AVR
        default "FALSE" if ! ENABLE_9H3_AVR

comment "================= Advanced Options: ================="

choice
	bool "PHY Speed"
	default SPEED_25G 
	help
	  PHY Speed of Transceive IP
          OC-ACCEL supports two choices of phy speed, please select
          one of them.
          25BGBps is the default.
          => Pay attention that 20GBps while reducing build time, requires server to be
             in a specific unsupported test mode !!
	config SPEED_25G
		bool "25G: Transceive IP default speed: 25.78125 Gbps"
		help
		  Generate Transceive IP with 25.78125 Gbps. Uses Xilinx IP.
	
	config SPEED_20G
		bool "20G: Transceive IP at 20.0 Gbps => See Help for warning"
		help
		  Generate Transceive IP with 20.0 Gbps. Uses Xilinx IP.
		  WARNING: While reducing build time, it requires server to be in a specific unsupported test mode !!
endchoice

config PHY_SPEED 
	string
	default "25.78125" if SPEED_25G
	default "20.0" if SPEED_20G

config AXI_ID_WIDTH
	        prompt "axi id width on oc-accel&action interface, range 1-5"
		int
		default 1
		range 1 5
		help
		  ID width on AXI interface
                  There are five choices of axi id width (1,2,3,4,5) the framework supports. 
	          Please select one of them.

choice
	bool "Clock Frequency for Action  "
	default Action_clock_200MHz
	help
	  Clock frequency for action
	  There are multiple frequencys the framework supports. Please select
	  one of them.

	config Action_clock_50MHz
		bool "Action work on 50MHz  (50.355MHz to be accurate) clock"
		select ACTION_USER_CLOCK
		help
		  Action use 50MHz clock. A different clock with oc-accel bridge. 

	config Action_clock_100MHz
		bool "Action work on 100MHz (100.710MHz to be accurate) clock"
		select ACTION_USER_CLOCK
		help
		  Action use 100MHz clock. A different clock with oc-accel bridge. 

	config Action_clock_150MHz
		bool "Action work on 150MHz (151.065MHz to be accurate) clock"
		select ACTION_USER_CLOCK
		help
		  Action use 150MHz clock. A different clock with oc-accel bridge. 

	config Action_clock_200MHz
		bool "Action work on 200MHz (201.420MHz to be accurate) clock"
		help
		  Action use 200MHz clock. Same clock with oc-accel bridge. 

	config Action_clock_250MHz
		bool "Action work on 250MHz (251.775MHz to be accurate) clock"
		select ACTION_USER_CLOCK
		help
		  Action use 250MHz clock. A different clock with oc-accel bridge. 

	config Action_clock_300MHz
		bool "Action work on 300MHz (302.130MHz to be accurate) clock"
		select ACTION_USER_CLOCK
		help
		  Action use 300MHz clock. A different clock with oc-accel bridge. 

	config Action_clock_350MHz
		bool "Action work on 350MHz (352.485MHz to be accurate) clock"
		select ACTION_USER_CLOCK
		help
		  Action use 350MHz clock. A different clock with oc-accel bridge. 

	config Action_clock_400MHz
		bool "Action work on 400MHz (402.840MHz to be accurate) clock"
		select ACTION_USER_CLOCK
		help
		  Action use 400MHz clock. A different clock with oc-accel bridge. 
endchoice

config USER_CLOCK_FREQ
	int
	default 50   if Action_clock_50MHz
	default 100  if Action_clock_100MHz
	default 150  if Action_clock_150MHz
	default 200  if Action_clock_200MHz
	default 250  if Action_clock_250MHz
	default 300  if Action_clock_300MHz
	default 350  if Action_clock_350MHz
	default 400  if Action_clock_400MHz

config ACTION_USER_CLOCK
	bool
	default y
        prompt "Action's clock frequency is 200MHz ('n', unchecked) or other clock frequency ('y', checked)"
	depends on OPENCAPI30 && (HDL_ACTION || HLS_ACTION)
	help
	  Input 'Y' if your action's clock frequency is not 200MHz.
	  Leave it unchecked if it is 200MHz.

config HLS_CLOCK_PERIOD_CONSTRAINT
	prompt "The HLS clock period constraint used when C code (only used for hls action)"
	string
	default "5ns"
	range "1ns" "20ns"
	help
	  The HLS clock period constraint in "ns" used when C code is compiled to rtl, 
	  By constraining differently HLS tool, packing logic may be different and give you better results.

#config ENABLE_PRFLOW
#	bool "Cloud build (enabling Partial Reconfiguration)"
#	help
#	  Used for Cloud environment using specific PSL images
#
#config USE_PRFLOW
#	string
#	default "TRUE" if ENABLE_PRFLOW
#	default "FALSE" if ! ENABLE_PRFLOW

config ENABLE_ILA
	bool "Enable ILA Debug"
	depends on ! ENABLE_PRFLOW
	help
	  Used for debugging the design by inserting probes into the FPGA
	  Enable the usage of Vivado's integrated logic analyzer. There are
	  two ways: 
	  (1) Use xdc file. Please make sure that $ILA_SETUP_FILE in snap_env.sh
	  points to the .xdc file (See example in hardware/setup/ila_example.xdc).
	  (2) Create an ILA ip core and instantiate it in your design. Put the "create_ip"
	  commands in your tcl file, and include the ila core in your Verilog design
	  (enclosed with `define ILA_DEBUG .... `endif)
	  For both ways, a 'probe.ltx' file will be generated in hardware/build/Images. 
	  This file is needed for ILA debugging with JTAG and Vivado Lab HW manager tool.

config ILA_DEBUG
	string
	default "TRUE"  if ENABLE_ILA
	default "FALSE" if ! ENABLE_ILA

#config ENABLE_FACTORY
#	bool "Also create a factory image"
#	help
#	  Used to generate a specific image to be located into the factory area
#	  Default image is in the user area.
#	  This specific factory area is used to recover from a bad user image
#	depends on ! ENABLE_PRFLOW
#
#config FACTORY_IMAGE
#	string
#	default "TRUE"  if ENABLE_FACTORY
#	default "FALSE" if ! ENABLE_FACTORY

#FIXME Cloud flow will be revised
config ENABLE_CLOUD_USER_FLOW
	bool "Cloud user flow"
	default y
	depends on ENABLE_PRFLOW

config CLOUD_USER_FLOW
	string
	default "TRUE" if ENABLE_CLOUD_USER_FLOW
	default "FALSE" if ! ENABLE_CLOUD_USER_FLOW

config ENABLE_CLOUD_BUILD_BITFILE
	bool "Build bitstream file"
	help
	  Enables the generation of the image for the FPGA
	default y
	depends on ENABLE_PRFLOW

config CLOUD_BUILD_BITFILE
	string
	default "TRUE" if ENABLE_CLOUD_BUILD_BITFILE
	default "FALSE" if ! ENABLE_CLOUD_BUILD_BITFILE


config ENABLE_UNIT_VERIF
	bool "Enable UVM based unit verification environment."
	depends on SIM_XCELIUM
	depends on HDL_UNIT_SIM
    default n
	help
	   OCSE and software excluded, only UVM based testbench and OC-ACCEL AXI-TLX bridge.

config UNIT_SIM_USED
	string
	default "TRUE"  if ENABLE_UNIT_VERIF
	default "FALSE" if ! ENABLE_UNIT_VERIF

#experimental - not available yet
#config ENABLE_ODMA
#	bool "Enable ODMA (not available)"
#    default n
#	help
#	   Enable ODMA instead of TLX-AXI bridge.

config ODMA_USED
	string
	default "TRUE"  if ENABLE_ODMA
	default "FALSE" if ! ENABLE_ODMA

#experimental - not available yet
#config ENABLE_ODMA_ST_MODE
#	bool "Enable ODMA AXI4-Stream data transfer mode."
#    default n
#	help
#	   Enable ODMA Stream mode.

config ODMA_ST_MODE_USED
	string
	default "TRUE"  if ENABLE_ODMA_ST_MODE
	default "FALSE" if ! ENABLE_ODMA_ST_MODE

#experimental - not available yet
#config ENABLE_ODMA_512
#	bool "Enable ODMA data transfer with 512b data width."
#    default n
#	help
#	   Enable ODMA data width with 512bits.

config ODMA_512_USED
	string
	default "TRUE"  if ENABLE_ODMA_512
	default "FALSE" if ! ENABLE_ODMA_512

config ENABLE_FLASH
	bool "Enable FLASH (Disabling will require JTAG programming)"
    default y
	help
	   Enable FLASH in oc-bip.

config FLASH_USED
	string
	default "TRUE"  if ENABLE_FLASH
	default "FALSE" if ! ENABLE_FLASH

config ENABLE_USERCODE
        bool "Enable USER CODE (code will be requested to user later on)"
        default n 
        help
          This allows user to define a user code associated to the FPGA content
          For ex user want to create 2 configuration with 2 different VIVADO versions

config USERCODE
        string "USERCODE(max64bits)"
        depends on ENABLE_USERCODE
        default "0000000000000000"
```
